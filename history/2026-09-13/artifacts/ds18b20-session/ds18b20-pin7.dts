/dts-v1/;

/ {
	jetson-header-name = "Jetson 40pin Header";
	overlay-name = "User Custom [2026-09-13-165132]";
	compatible = "nvidia,p3768-0000+p3767-0000\0nvidia,p3768-0000+p3767-0001\0nvidia,p3768-0000+p3767-0003\0nvidia,p3768-0000+p3767-0004\0nvidia,p3768-0000+p3767-0005\0nvidia,p3768-0000+p3767-0000-super\0nvidia,p3768-0000+p3767-0001-super\0nvidia,p3768-0000+p3767-0003-super\0nvidia,p3768-0000+p3767-0004-super\0nvidia,p3768-0000+p3767-0005-super\0nvidia,p3509-0000+p3767-0000\0nvidia,p3509-0000+p3767-0001\0nvidia,p3509-0000+p3767-0003\0nvidia,p3509-0000+p3767-0004\0nvidia,p3509-0000+p3767-0005";

	fragment@0 {
		target = <0xffffffff>;

		__overlay__ {
			pinctrl-names = "default";
			pinctrl-0 = <0x01>;

			exp-header-pinmux {
                phandle = <0x01>;
                hdr40-pin7 {
                    nvidia,pins = "soc_gpio59_pac6";
                    nvidia,function = "rsvd2";
                    nvidia,pull = <0>;
                    nvidia,tristate = <0>;
                    nvidia,enable-input = <1>;
                };


				hdr40-pin15 {
					nvidia,pins = "soc_gpio39_pn1";
					nvidia,function = "rsvd1";
					nvidia,pull = <0x00>;
					nvidia,tristate = <0x00>;
					nvidia,enable-input = <0x01>;
				};

				hdr40-pin19 {
					nvidia,pins = "spi1_mosi_pz5";
					nvidia,function = "spi1";
					nvidia,tristate = <0x00>;
					nvidia,enable-input = <0x01>;
				};

				hdr40-pin21 {
					nvidia,pins = "spi1_miso_pz4";
					nvidia,function = "spi1";
					nvidia,tristate = <0x00>;
					nvidia,enable-input = <0x01>;
				};

				hdr40-pin23 {
					nvidia,pins = "spi1_sck_pz3";
					nvidia,function = "spi1";
					nvidia,tristate = <0x00>;
					nvidia,enable-input = <0x01>;
				};

				hdr40-pin24 {
					nvidia,pins = "spi1_cs0_pz6";
					nvidia,function = "spi1";
					nvidia,tristate = <0x00>;
					nvidia,enable-input = <0x01>;
				};

				hdr40-pin26 {
					nvidia,pins = "spi1_cs1_pz7";
					nvidia,function = "spi1";
					nvidia,tristate = <0x00>;
					nvidia,enable-input = <0x01>;
				};
			};
		};
	};

	fragment@1 {
		target = <0xffffffff>;

		__overlay__ {
			pinctrl-names = "default";
			pinctrl-0 = <0x02>;

			exp-header-pinmux {
				phandle = <0x02>;
			};
		};
	};

    fragment@2 {
        target-path = "/";
        __overlay__ {
            onewire {
                compatible = "w1-gpio";
                gpios = <0xffffffff 166 0>;
                status = "okay";
            };
        };
    };

	__symbols__ {
		jetson_io_pinmux = "/fragment@0/__overlay__/exp-header-pinmux";
		jetson_io_pinmux_aon = "/fragment@1/__overlay__/exp-header-pinmux";
	};

	__fixups__ {
        gpio = "/fragment@2/__overlay__/onewire:gpios:0";
		pinmux = "/fragment@0:target:0";
		pinmux_aon = "/fragment@1:target:0";
	};

	__local_fixups__ {

		fragment@0 {

			__overlay__ {
				pinctrl-0 = <0x00>;
			};
		};

		fragment@1 {

			__overlay__ {
				pinctrl-0 = <0x00>;
			};
		};
	};
};
